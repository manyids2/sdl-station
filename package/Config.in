## package/Config.in
```kconfig
config BR2_PACKAGE_SDLSTATION
        bool "sdl-station"
	depends on BR2_INSTALL_LIBSTDCPP
	select BR2_PACKAGE_SDL2
	select BR2_PACKAGE_SDL2_MIXER
	select BR2_PACKAGE_ALSA_LIB
	select BR2_PACKAGE_ALSA_UTILS_AMIXER
	depends on (BR2_PACKAGE_HAS_LIBGLES || BR2_PACKAGE_HAS_LIBGL)
	select BR2_PACKAGE_LIBFREEIMAGE
	select BR2_PACKAGE_FREETYPE
	select BR2_PACKAGE_DEJAVU
	select BR2_PACKAGE_OPENSSL
	select BR2_PACKAGE_NANUM_FONT
	select BR2_PACKAGE_FPING
	select BR2_PACKAGE_BATOCERA_EMULATIONSTATION_FONTS
	select BR2_PACKAGE_POPPLER
	select BR2_PACKAGE_POPPLER_UTILS
	select BR2_PACKAGE_OPENJPEG # for poppler
	select BR2_PACKAGE_JPEG     # for poppler
    select BR2_PACKAGE_FFMPEG
    select BR2_PACKAGE_FFMPEG_GPL
	select BR2_PACKAGE_FFMPEG_FFPROBE
	select BR2_PACKAGE_FFMPEG_AVRESAMPLE
	select BR2_PACKAGE_FFMPEG_SWSCALE
	select BR2_PACKAGE_FFMPEG_POSTPROC

        help
          An sdl frontend.

	  https://github.com/manyids2/sdl-station

comment "sdl-station needs a toolchain w/ C++, SDL2 support"
```
